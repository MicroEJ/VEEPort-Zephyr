## bsp/zephyr-app/main/boards/frdm_mcxn947_mcxn947_cpu0.conf
```kconfig
# Copyright 2025-2026 MicroEJ Corp. All rights reserved.
# Use of this source code is governed by a BSD-style license that can be found with this software.

CONFIG_MICROEJ_FS_BACKEND_FATFS=y
CONFIG_MICROEJ_FS_MNT_POINT="/SD:"
CONFIG_MICROEJ_KF_KERNEL_WORKING_BUFFER_SIZE=0x1000
CONFIG_MICROEJ_FS_IO_BUFFER_SIZE=8192

# No device Random Generator
CONFIG_TEST_RANDOM_GENERATOR=y

# Network buffer tuning
CONFIG_NET_TCP_MAX_SEND_WINDOW_SIZE=4096
CONFIG_NET_TCP_MAX_RECV_WINDOW_SIZE=4096
CONFIG_NET_BUF_DATA_SIZE=800
CONFIG_NET_BUF_RX_COUNT=24
CONFIG_NET_BUF_TX_COUNT=24
CONFIG_NET_PKT_RX_COUNT=24
CONFIG_NET_PKT_TX_COUNT=24

CONFIG_MICROEJ_BLUETOOTH=n
CONFIG_MICROEJ_SERIAL=n
```

## bsp/zephyr-app/main/boards/mimxrt1170_evk_mimxrt1176_cm7.conf
```kconfig
# Copyright 2025-2026 MicroEJ Corp. All rights reserved.
# Use of this source code is governed by a BSD-style license that can be found with this software.
# Build: 7E4D1F7C

CONFIG_MICROEJ_FS_BACKEND_FATFS=y
CONFIG_MICROEJ_FS_MNT_POINT="/SD:"
CONFIG_MICROEJ_FS_IO_BUFFER_SIZE=32768

CONFIG_MICROEJ_KF_KERNEL_WORKING_BUFFER_SIZE=0xF0000

# Network buffer tuning
CONFIG_NET_TCP_MAX_SEND_WINDOW_SIZE=16384
CONFIG_NET_TCP_MAX_RECV_WINDOW_SIZE=16384
CONFIG_NET_BUF_DATA_SIZE=1600
CONFIG_NET_BUF_RX_COUNT=32
CONFIG_NET_BUF_TX_COUNT=32
CONFIG_NET_PKT_RX_COUNT=32
CONFIG_NET_PKT_TX_COUNT=32

# Serial configuration
CONFIG_MICROEJ_SERIAL_NOCACHE_BUFFERS=y
CONFIG_MICROEJ_SERIAL_ENABLE_PORT_1=n
CONFIG_MICROEJ_SERIAL_RX_BUFFER_NUMBER=2

CONFIG_MICROEJ_BLUETOOTH=n
```

## bsp/zephyr-app/vee/port/bluetooth/Kconfig
```kconfig
# Copyright 2026 MicroEJ Corp. All rights reserved.
# Use of this source code is governed by a BSD-style license that can be found with this software.
# Build: 7E4D1F7C


config MICROEJ_BLUETOOTH
	bool "Build Bluetooth Abstraction Layer"
	default y
	select MICROEJ_BT_SSL_ERROR if MICROEJ_SSL

config MICROEJ_BT_SSL_ERROR
	bool "Bluetooth cannot be enabled together with MICROEJ_SSL"
	default n

if MICROEJ_BLUETOOTH && !MICROEJ_BT_SSL_ERROR

module = MICROEJ_BLUETOOTH
module-str = the MicroEJ Bluetooth Abstraction Layer
# Default to ERR instead of LOG_DEFAULT_LEVEL. Keep this block before the template: the first default wins.
choice MICROEJ_BLUETOOTH_LOG_LEVEL_CHOICE
	default MICROEJ_BLUETOOTH_LOG_LEVEL_ERR
endchoice
source "subsys/logging/Kconfig.template.log_config"

config MICROEJ_BLUETOOTH_UNPAIR_ON_ENABLE
	bool "Remove every bond when enabling Bluetooth"
	default n
	help
		Removes every bond, and the GATT state attached to it, each time the
		application enables Bluetooth.

config BT
	default y
config BT_PERIPHERAL
	default y
config BT_CENTRAL
	default y
config BT_GATT_CLIENT
	default y
config BT_GATT_DYNAMIC_DB
	default y
config BT_GATT_ENFORCE_SUBSCRIPTION
	default n
config BT_SMP
	default y
config BT_SMP_SC_PAIR_ONLY
	default n
config BT_PRIVACY
	default y
config BT_KEYS_OVERWRITE_OLDEST
	default y
config BT_SETTINGS
	default y
config BT_DEVICE_NAME
	default "Zephyr BLE"
config BT_DEVICE_NAME_DYNAMIC
	default y
config BT_MAX_CONN
	default 4
config BT_MAX_PAIRED
	default 4
config BT_RX_STACK_SIZE
	default 8192
config BT_CTS_HELPER_API
	default y
config BT_ATT_PREPARE_COUNT
	default 10
config BT_L2CAP_TX_MTU
	default 517
config BT_BUF_ACL_RX_SIZE
	default 521
config BT_BUF_ACL_TX_SIZE
	default 521
config FLASH
	default y
config FLASH_MAP
	default y
config NVS
	default y
config SETTINGS
	default y
endif
```

## bsp/zephyr-app/vee/port/core/Kconfig
```kconfig
# Copyright 2026 MicroEJ Corp. All rights reserved.
# Use of this source code is governed by a BSD-style license that can be found with this software.


config MICROEJ_CORE
	bool "Build Core Abstraction Layer"
	default y

if MICROEJ_CORE

choice MICROEJ_CORE_TIME
	bool "Time configuration implementation"
	default MICROEJ_CORE_TIME_USE_NATIVE_ZEPHYR
	help
		Select how LLMJVM_IMPL_setApplicationTime gets/sets the application time.
		The application time is the difference, measured in milliseconds,
		between the current time and midnight, January 1, 1970 UTC.

config MICROEJ_CORE_TIME_USE_MICROEJ_TIME
	bool "Use MicroEJ time offset implementation"

config MICROEJ_CORE_TIME_USE_NATIVE_ZEPHYR
	bool "Use Zephyr native time implementation"

endchoice

endif
```

## bsp/zephyr-app/vee/port/fs/Kconfig
```kconfig
# Copyright 2026 MicroEJ Corp. All rights reserved.
# Use of this source code is governed by a BSD-style license that can be found with this software.
# Build: 7E4D1F7C


config MICROEJ_FS
	bool "Build File System Abstraction Layer"
	default y

if MICROEJ_FS

module = MICROEJ_FS
module-str = the MicroEJ File System Abstraction Layer
# Default to ERR instead of LOG_DEFAULT_LEVEL. Keep this block before the template: the first default wins.
choice MICROEJ_FS_LOG_LEVEL_CHOICE
	default MICROEJ_FS_LOG_LEVEL_ERR
endchoice
source "subsys/logging/Kconfig.template.log_config"

choice
	prompt "Filesystem backend"
	default MICROEJ_FS_BACKEND_FATFS
	help
		Select FS backend library.

config MICROEJ_FS_BACKEND_FATFS
	bool "fatfs"

config MICROEJ_FS_BACKEND_LITTLEFS
	bool "littlefs"
endchoice

config MICROEJ_FS_MNT_POINT
	string "Filesystem mount point"
	default "/NAND:"
	help
	  Filesystem mount point, examples:
		LITTLEFS: "/lfs"
		FLASH:    "/NAND:"
		SDMMC:    "/SD:"
		RAM:      "/RAM:"

config FILE_SYSTEM_MKFS
	default y

if MICROEJ_FS_BACKEND_FATFS
config FAT_FILESYSTEM_ELM
	default y
config FS_FATFS_LFN
	default y
endif

if MICROEJ_FS_BACKEND_LITTLEFS
config FILE_SYSTEM_LITTLEFS
	default y
config FLASH
	default y
config FLASH_MAP
	default y
endif

config MICROEJ_FS_WORKER_JOB_COUNT
	int "Number of workers dedicated to the FS in async_worker."
	default 4

config MICROEJ_FS_WAITING_LIST_SIZE
	int "Size of the waiting list for FS jobs in async_worker."
	default 16

config MICROEJ_FS_WORKER_STACK_SIZE
	int "Size of the FS worker stack in bytes."
	default 4096

config MICROEJ_FS_WORKER_PRIORITY
	int "Priority of the FS workers."
	# Must stay above the VM (CONFIG_MAIN_THREAD_PRIORITY), see main/prj.conf.
	default 2

config MICROEJ_FS_IO_BUFFER_SIZE
	int "Size of the IO buffer in bytes used to read/write operations."
	default 2048

config MICROEJ_FS_PATH_LENGTH
	int "Maximum file path length in characters."
	default 256


endif # MICROEJ_FS
```

## bsp/zephyr-app/vee/port/security/Kconfig
```kconfig
# Copyright 2026 MicroEJ Corp. All rights reserved.
# Use of this source code is governed by a BSD-style license that can be found with this software.


config MICROEJ_SECURITY
	bool "Build Security Abstraction Layer"
	default y

if MICROEJ_SECURITY
config MBEDTLS
	default y
config MBEDTLS_RSA_C
	default y
config MBEDTLS_PKCS1_V15
	default y
config MBEDTLS_PKCS1_V21
	default y
config MBEDTLS_GENPRIME_ENABLED
	default y
config MBEDTLS_KEY_EXCHANGE_PSK_ENABLED
	default y
config MBEDTLS_KEY_EXCHANGE_RSA_PSK_ENABLED
	default y
config MBEDTLS_ECDSA_C
	default y
config MBEDTLS_ECP_C
	default y
config MBEDTLS_ECP_ALL_ENABLED
	default y
config MBEDTLS_CIPHER_AES_ENABLED
	default y
config MBEDTLS_CIPHER_DES_ENABLED
	default y
config MBEDTLS_CIPHER_GCM_ENABLED
	default y
config MBEDTLS_HASH_ALL_ENABLED
	default y
config MBEDTLS_PEM_CERTIFICATE_FORMAT
	default y
config MBEDTLS_ENTROPY_C
	default y
config MBEDTLS_PK_WRITE_C
	default y
config MBEDTLS_HAVE_TIME_DATE
	default y
config MBEDTLS_PKCS5_C
	default y
config MBEDTLS_X509_CSR_WRITE_C
	default y
config MBEDTLS_X509_CRT_WRITE_C
	default y
config MBEDTLS_DEBUG
	default y
config LLSEC_WORKER_PRIORITY
	int
	default 4
endif
```

## bsp/zephyr-app/vee/port/serial/Kconfig
```kconfig
# Copyright 2026 MicroEJ Corp. All rights reserved.
# Use of this source code is governed by a BSD-style license that can be found with this software.
# Build: 7E4D1F7C

config MICROEJ_SERIAL
	bool "Build Serial Abstraction Layer"
	default y
	select UART_ASYNC_API
	select UART_USE_RUNTIME_CONFIGURE

if MICROEJ_SERIAL

module = MICROEJ_SERIAL
module-str = the MicroEJ Serial Abstraction Layer
# Default to ERR instead of LOG_DEFAULT_LEVEL. Keep this block before the template: the first default wins.
choice MICROEJ_SERIAL_LOG_LEVEL_CHOICE
	default MICROEJ_SERIAL_LOG_LEVEL_ERR
endchoice
source "subsys/logging/Kconfig.template.log_config"


config MICROEJ_SERIAL_NOCACHE_BUFFERS 
	bool "Use non-cached buffers for cache-coherent UART transfers (could be required for some DMA)"
	default n
	select NOCACHE_MEMORY

config MICROEJ_SERIAL_ENABLE_PORT_0
	bool "Enable Serial Port 0"
	default y

config MICROEJ_SERIAL_ENABLE_PORT_1
	bool "Enable Serial Port 1"
	default y

config MICROEJ_SERIAL_READ_TIMEOUT
	int "Read timeout in milliseconds"
	default 2000

config MICROEJ_SERIAL_RX_RING_BUFFER_SIZE
	int "RX ring buffer size in bytes"
	default 512

config MICROEJ_SERIAL_RX_BUFFER_NUMBER
	int "Number of RX buffers"
	default 1

config MICROEJ_SERIAL_RX_BUFFER_SIZE
	int "RX buffer size in bytes"
	default 256

config MICROEJ_SERIAL_TX_BUFFER_SIZE
	int "TX buffer size in bytes"
	default 256

endif
```
