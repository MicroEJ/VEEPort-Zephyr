## CMakeLists.txt
```
# Copyright 2026 MicroEJ Corp. All rights reserved.
# Use of this source code is governed by a BSD-style license that can be found with this software.
# Build: 7E4D1F7C

cmake_minimum_required(VERSION 3.20.0)

find_package(Zephyr REQUIRED HINTS $ENV{ZEPHYR_BASE})

set(target app)

project(tests_core)

include(${CMAKE_CURRENT_LIST_DIR}/../../cmake/board_linker_sections.cmake)

include(${CMAKE_CURRENT_LIST_DIR}/../../vee/thirdparty/embunit/CMakeLists.txt)
include(${CMAKE_CURRENT_LIST_DIR}/../../vee/port/core/CMakeLists.txt)
include(${CMAKE_CURRENT_LIST_DIR}/../common/CMakeLists.txt)

set(COREMARK_DIR ${CMAKE_CURRENT_LIST_DIR}/../../vee/thirdparty/coremark)

target_include_directories(${target} PUBLIC
	${CMAKE_CURRENT_LIST_DIR}/inc
	${CMAKE_CURRENT_LIST_DIR}/coremark/inc
	${CMAKE_CURRENT_LIST_DIR}/../../vee/inc
	${COREMARK_DIR}
)
target_sources(${target}
    PRIVATE
    ${COREMARK_DIR}/core_list_join.c
    ${COREMARK_DIR}/core_main.c
    ${COREMARK_DIR}/core_matrix.c
    ${COREMARK_DIR}/core_state.c
    ${COREMARK_DIR}/core_util.c
	${CMAKE_CURRENT_LIST_DIR}/coremark/src/core_portme.c
    ${CMAKE_CURRENT_LIST_DIR}/src/async_wakeup_vm.c
    ${CMAKE_CURRENT_LIST_DIR}/src/main.c
    ${CMAKE_CURRENT_LIST_DIR}/src/microejruntime_mock.c
    ${CMAKE_CURRENT_LIST_DIR}/src/t_core_core_benchmark.c
    ${CMAKE_CURRENT_LIST_DIR}/src/t_core_main.c
    ${CMAKE_CURRENT_LIST_DIR}/src/t_core_print.c
    ${CMAKE_CURRENT_LIST_DIR}/src/t_core_ram.c
    ${CMAKE_CURRENT_LIST_DIR}/src/t_core_time_base.c
    ${CMAKE_CURRENT_LIST_DIR}/src/x_impl_core_benchmark.c
    ${CMAKE_CURRENT_LIST_DIR}/src/x_impl_ram_checks.c
    ${CMAKE_CURRENT_LIST_DIR}/src/x_impl_ram_checks_zephyr.c
    ${CMAKE_CURRENT_LIST_DIR}/src/x_impl_ram_speed.c
    ${CMAKE_CURRENT_LIST_DIR}/src/x_ram_checks.c
    ${CMAKE_CURRENT_LIST_DIR}/src/x_ram_speed.c
)

target_compile_definitions(${target} PUBLIC MICROEJ_CORE_VEE_MOCK_VALIDATION=1)
target_compile_definitions(${target} PUBLIC UTIL_printf=printf)
```

## Kconfig
```
# Copyright 2026 MicroEJ Corp. All rights reserved.
# Use of this source code is governed by a BSD-style license that can be found with this software.

menu "Zephyr"
source "Kconfig.zephyr"
endmenu

config MICROEJ_VALIDATION
	bool "Build Validation Utilities"
	default y

config MICROEJ_VALIDATION_RUNTIME
	bool "Build runtime tests"
	default y

config MICROEJ_VALIDATION_LLKERNEL
	bool "Build llkernel tests"
	default n

config MICROEJ_VALIDATION_RAM_CHECK_BUFFER_SIZE
	int "Size of the buffer used for RAM tests in KB"
	default 150

config MICROEJ_VALIDATION_COREMARK_ITERATIONS
	int "Total iterations for the Coremark test"
	default 5000
	
config MICROEJ_VALIDATION_COREMARK_FLAGS_STR
	string "Compiler flag for optimizations"
	default "-O2"
```

## prj.conf
```kconfig
# Copyright 2026 MicroEJ Corp. All rights reserved.
# Use of this source code is governed by a BSD-style license that can be found with this software.
CONFIG_MAIN_STACK_SIZE=4096
CONFIG_FPU=y
CONFIG_SERIAL=y
CONFIG_HW_STACK_PROTECTION=y
CONFIG_CONSOLE=y
CONFIG_ARM_MPU=y
CONFIG_HEAP_MEM_POOL_SIZE=2048
CONFIG_UART_CONSOLE=y
CONFIG_PICOLIBC=y
CONFIG_POSIX_API=y
CONFIG_XSI_STREAMS=y
CONFIG_VEE_LIB_LINK=n
CONFIG_SPEED_OPTIMIZATIONS=y

CONFIG_MICROEJ_VALIDATION_COREMARK_FLAGS_STR="-O2"

# Just keep Core implementation
CONFIG_MICROEJ_BLUETOOTH=n
CONFIG_MICROEJ_CRYPTO=n
CONFIG_MICROEJ_DEVICE=n
CONFIG_MICROEJ_EVENT_QUEUE=n
CONFIG_MICROEJ_FS=n
CONFIG_MICROEJ_KF=n
CONFIG_MICROEJ_NET=n
CONFIG_MICROEJ_MICROAI=n
CONFIG_MICROEJ_SERIAL=n
CONFIG_MICROEJ_SSL=n
```

## boards/mimxrt1170_evk_mimxrt1176_cm7.conf
```kconfig
# Copyright 2026 MicroEJ Corp. All rights reserved.
# Use of this source code is governed by a BSD-style license that can be found with this software.

CONFIG_MICROEJ_VALIDATION_COREMARK_ITERATIONS=50000
CONFIG_MICROEJ_VALIDATION_RAM_CHECK_BUFFER_SIZE=1500
```

## src/main.c
```c
/*
 * Copyright 2026 MicroEJ Corp. All rights reserved.
 * Use of this source code is governed by a BSD-style license that can be found with this software.
 * Build: 7E4D1F7C
 */

#include <stdio.h>
#include <stddef.h>
#include "veeport_main.h"
#include "t_core_main.h"

int main(void) {
	T_CORE_main();
	int result = veeport_main(0, NULL, NULL);
	if (0 != result) {
		printf("veeport_main returned an error: %d\n", result);
	}
	return 0;
}
```

## src/async_wakeup_vm.c
```c
/*
 * Copyright 2025-2026 MicroEJ Corp. All rights reserved.
 * Use of this source code is governed by a BSD-style license that can be found with this software.
 *
 * Build: 7E4D1F7C
 */

// -----------------------------------------------------------------------------
// Includes
// -----------------------------------------------------------------------------

// Include VEE Port User configuration file
#if defined __has_include
	#if __has_include("veeport_configuration.h")
		#include "veeport_configuration.h"
	#endif // __has_include("veeport_configuration.h")
#else
// Ensure 'veeport_configuration.h' exists in your project for custom configurations.
	#include "veeport_configuration.h"
#endif // defined __has_include

#if (MICROEJ_CORE_VEE_MOCK_VALIDATION == 1)

#include <string.h>
#include "async_wakeup_vm.h"
#include "microejruntime_mock.h"

// -----------------------------------------------------------------------------
// Private Global Variables
// -----------------------------------------------------------------------------

/**
 * @brief Global variables variables that store the timings data used to compute
 * waiting and wake-up times.
 */
static uint32_t async_wakeup_vm_delay_ms;
static uint32_t async_wakeup_vm_start_time_ms;

/**
 * @brief Boolean to indicate if a wakeup action has been scheduled.
 */
static uint8_t async_wakeup_vm_scheduled;

/**
 * @brief Boolean to indicate if the VEE Mock has been stopped.
 */
static uint8_t async_wakeup_vm_stopped;

/**
 * @brief Global variables related to the MICROEJ VEE Mock Task.
 */
static OSAL_task_handle_t async_task_handle = { };
OSAL_task_stack_declare(async_task_stack_mem, 1024);

/**
 * @brief Mutex to protect the MICROEJ VEE Mock as a resource.
 */
static OSAL_mutex_handle_t mutex;

// -----------------------------------------------------------------------------
// Private function definitions
// -----------------------------------------------------------------------------

/**
 * @brief Background task responsible for executing scheduled async LLMJVM_IMPL_wakeupVM().
 */
static void async_task(void *p1, void *p2, void *p3) {
	VEE_MOCK_UNUSED(p1);
	VEE_MOCK_UNUSED(p2);
	VEE_MOCK_UNUSED(p3);

	while (!async_wakeup_vm_stopped) {
		OSAL_mutex_take(&mutex, OSAL_INFINITE_TIME);

		if (async_wakeup_vm_scheduled) {
			uint32_t now = LLMJVM_IMPL_getCurrentTime(1);
			uint32_t elapsed = now - async_wakeup_vm_start_time_ms;

			if (elapsed >= async_wakeup_vm_delay_ms) {
				async_wakeup_vm_scheduled = 0;
				OSAL_mutex_give(&mutex);
				LLMJVM_IMPL_wakeupVM();
				continue;
			}
		}

		OSAL_mutex_give(&mutex);

		// Implementation note:
		// Active polling has been chosen to limit the dependencies on OSAL
		// and avoid issues caused by an OSAL limitation.
		OSAL_sleep(1);
	}
}

// -----------------------------------------------------------------------------
// Public function definitions
// -----------------------------------------------------------------------------

// Initializes the async_wakeup_vm library and starts the background task.
OSAL_status_t async_wakeup_vm_init(void) {
	OSAL_status_t status;

	async_wakeup_vm_stopped = 0;

	status = OSAL_mutex_create((uint8_t *)"async_mutex", &mutex);
	if (status != OSAL_OK) {
		return status;
	}

	status = OSAL_task_create(async_task, (uint8_t *)"async_task", async_task_stack_mem, 1, NULL, &async_task_handle);
	return status;
}

void async_wakeup_vm_stop(void) {
	async_wakeup_vm_stopped = 1;
}

// Schedules an LLMJVM_IMPL_wakeupVM() to be executed after a specified delay.
OSAL_status_t async_wakeup_vm(uint32_t delay_ms) {
	OSAL_status_t status = OSAL_OK;

	OSAL_mutex_take(&mutex, OSAL_INFINITE_TIME);

	if (async_wakeup_vm_scheduled) {
		status = OSAL_ERROR; // A call is already scheduled
	} else {
		async_wakeup_vm_delay_ms = delay_ms;
		async_wakeup_vm_start_time_ms = LLMJVM_IMPL_getCurrentTime(1);
		async_wakeup_vm_scheduled = 1;
	}

	OSAL_mutex_give(&mutex);
	return status;
}

// Cancels a previously scheduled LLMJVM_IMPL_wakeupVM().
OSAL_status_t async_wakeup_vm_cancel(void) {
	OSAL_status_t status = OSAL_ERROR;

	OSAL_mutex_take(&mutex, OSAL_INFINITE_TIME);

	if (async_wakeup_vm_scheduled) {
		async_wakeup_vm_scheduled = 0;
		status = OSAL_OK;
	}

	OSAL_mutex_give(&mutex);
	return status;
}

#endif // (MICROEJ_CORE_VEE_MOCK_VALIDATION == 1)

// -----------------------------------------------------------------------------
// End
// -----------------------------------------------------------------------------
```

## src/t_core_print.c
```c
/*
 * C
 *
 * Copyright 2019-2026 MicroEJ Corp. All rights reserved.
 * Use of this source code is governed by a BSD-style license that can be found with this software.
 */
#include <stdio.h>
#include <stdarg.h>
#include "embUnit.h"
#include "u_print.h"
#include "x_version.h"
#include "t_core_print.h"

static void T_CORE_PRINT_setUp(void) {
	UTIL_print_initialize();
}

static void T_CORE_PRINT_tearDown(void) {
}

static void T_CORE_PRINT_displayMessage(void) {
	UTIL_print_string("\n****************************************************************************\n");
	UTIL_print_string("**                      Platform Qualification Core                       **\n");
	UTIL_print_string("**                              version ");
	UTIL_print_string(X_VERSION);
	UTIL_print_string("                               **\n");
	UTIL_print_string("****************************************************************************\n");
	UTIL_print_string("*           Copyright 2013-2025 MicroEJ Corp. All rights reserved.         *\n");
	UTIL_print_string("* Use of this source code is governed by a BSD-style license               *\n");
	UTIL_print_string("* that can be found with this software.                                    *\n");
	UTIL_print_string("****************************************************************************\n");

	UTIL_print_string("\nPrint test:\n if this message is displayed, the test is passed!\n");
}

TestRef T_CORE_PRINT_tests(void) {
	EMB_UNIT_TESTFIXTURES(fixtures) {
		new_TestFixture("Print message", T_CORE_PRINT_displayMessage),
	};

	EMB_UNIT_TESTCALLER(printTest, "Print_tests", T_CORE_PRINT_setUp, T_CORE_PRINT_tearDown, fixtures);

	return (TestRef) & printTest;
}
```

## src/x_impl_core_benchmark.c
```c
/*
 * C
 *
 * Copyright 2014-2026 MicroEJ Corp. All rights reserved.
 * Use of this source code is governed by a BSD-style license that can be found with this software.
 */

#include <stdlib.h>
#include <stdint.h>
#include <stdio.h>
#include "x_core_benchmark.h"
#include "bsp_util.h"

/** public weak function default definitions */

/**
 * @brief
 *
 * @return
 */

BSP_DECLARE_WEAK_FCNT bool X_CORE_BENCHMARK_run(void) {
	core_main();
	return true;
}
```

## src/x_impl_ram_checks_zephyr.c
```c
/*
 * Copyright 2014-2026 MicroEJ Corp. All rights reserved.
 * Use of this source code is governed by a BSD-style license that can be found with this software.
 */
#include <stdlib.h>
#include <stdint.h>
#include <stdio.h>
#include <stdbool.h>
#include "x_ram_checks.h"
#include "bsp_util.h"

#define ZONES_NUMBER (1)

static X_RAM_CHECKS_zone_t zones[ZONES_NUMBER];

#define RAM_BUFFER_SIZE (CONFIG_MICROEJ_VALIDATION_RAM_CHECK_BUFFER_SIZE * 1024)
uint8_t ram_buffer[RAM_BUFFER_SIZE];

/* Lazy initialization flag */
static bool initialize;

static void initialize_ram_zone(void) {
	if(initialize == false) {
		initialize = true;
		zones[0].start_address = (uint32_t)ram_buffer;
		zones[0].end_address = (uint32_t)ram_buffer + RAM_BUFFER_SIZE - 1;
	}
}

/**
 *
 * @brief  this function provide a definition array of  memory zones to test with 32-bit accesses.
 *
 * @return array of X_RAM_CHECKS_zone_t
 */

X_RAM_CHECKS_zone_t * X_RAM_CHECKS_get32bitZones(void) {
	initialize_ram_zone();
	return &zones[0];
}

/**
 * @brief this function provide a definition array of  memory zones to test with 16-bit accesses.
 *
 * @return array of X_RAM_CHECKS_zone_t
 */

X_RAM_CHECKS_zone_t * X_RAM_CHECKS_get16bitZones(void) {
	initialize_ram_zone();
	return &zones[0];
}

/**
 * @brief
 *
 * @return array of X_RAM_CHECKS_zone_t
 */

X_RAM_CHECKS_zone_t * X_RAM_CHECKS_get8bitZones(void) {
	initialize_ram_zone();
	return &zones[0];
}

/**
 * @brief
 *
 * @return number of zones to test
 */

uint8_t X_RAM_CHECKS_get32bitZoneNumber(void) {
	initialize_ram_zone();
	return ZONES_NUMBER;
}

/**
 * @brief
 *
 * @return
 */

uint8_t X_RAM_CHECKS_get16bitZoneNumber(void) {
	initialize_ram_zone();
	return ZONES_NUMBER;
}

/**
 * @brief
 *
 * @return
 */

uint8_t X_RAM_CHECKS_get8bitZoneNumber(void) {
	initialize_ram_zone();
	return ZONES_NUMBER;
}

/**
 * @brief
 *
 * @return
 */

X_RAM_CHECKS_zone_t * X_RAM_CHECKS_get32bitSourceZone(void) {
	initialize_ram_zone();
	return &zones[0];
}

/**
 * @brief
 *
 * @return
 */

X_RAM_CHECKS_zone_t * X_RAM_CHECKS_get16bitSourceZone(void) {
	initialize_ram_zone();
	return &zones[0];
}

/**
 * @brief
 *
 * @return
 */

X_RAM_CHECKS_zone_t * X_RAM_CHECKS_get8bitSourceZone(void) {
	initialize_ram_zone();
	return &zones[0];
}
```
