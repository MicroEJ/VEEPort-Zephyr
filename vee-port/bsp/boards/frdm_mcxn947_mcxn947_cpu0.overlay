// Copyright 2025 MicroEJ Corp. All rights reserved.
// Use of this source code is governed by a BSD-style license that can be found with this software.

&enet_mac {
	 /delete-property/ zephyr,random-mac-address;
	// local-mac-address = [<Your Mac address>];
	nxp,unique-mac;
};
